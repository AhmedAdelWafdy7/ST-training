## Heap_Memory_Mangment/EmbeddedLinux_installation/meta-HMM/conf/layer.conf
```bitbake
# We have a conf and classes directory, add to BBPATH
BBPATH .= ":${LAYERDIR}"

# We have recipes-* directories, add to BBFILES
BBFILES += "${LAYERDIR}/recipes-*/*/*.bb \
${LAYERDIR}/recipes-*/*/*.bbappend \
${LAYERDIR}/recipes-*/*.bb \
${LAYERDIR}/recipes-*/*.bbappend "

BBFILE_COLLECTIONS += "HMM"
BBFILE_PATTERN_HMM = "^${LAYERDIR}/"
BBFILE_PRIORITY_HMM = "1"

LAYERVERSION_HMM = "1"
```
